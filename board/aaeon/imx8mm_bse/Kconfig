## board/aaeon/imx8mm_bse/Kconfig
```kconfig
if TARGET_IMX8MM_BSE

config SYS_BOARD
	default "imx8mm_bse"

config SYS_VENDOR
	default "aaeon"

config SYS_CONFIG_NAME
	default "imx8mm_bse"

source "board/freescale/common/Kconfig"

endif
```

## board/aaeon/imx8mm_srg/Kconfig
```kconfig
if TARGET_IMX8MM_SRG

config SYS_BOARD
	default "imx8mm_srg"

config SYS_VENDOR
	default "aaeon"

config SYS_CONFIG_NAME
	default "imx8mm_srg"

source "board/freescale/common/Kconfig"

endif
```
